## conf/layer.conf
```bitbake
BBPATH .= ":${LAYERDIR}"
BBFILES += "${LAYERDIR}/recipes-*/*/*.bb \   
    ${LAYERDIR}/recipes-*/*/*.bbappend"
BBFILE_COLLECTIONS += "ecepi"
BBFILE_PATTERN_ecepi = "^${LAYERDIR}/"
BBFILE_PRIORITY_ecepi = "6"

LAYERSERIES_COMPAT_ecepi = "mickledore"

LAYERDEPENDS_ecepi-layer = "core"
```
